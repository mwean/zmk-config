## boards/shields/myboard/Kconfig.shield
```kconfig
# Copyright (c) 2020 Pete Johanson
# SPDX-License-Identifier: MIT

config SHIELD_MYBOARD_LEFT
	def_bool $(shields_list_contains,myboard_left)

config SHIELD_MYBOARD_RIGHT
	def_bool $(shields_list_contains,myboard_right)
```

## config/boards/shields/myboard/Kconfig.defconfig
```kconfig
if SHIELD_MYBOARD_LEFT

config ZMK_KEYBOARD_NAME
	default "Myboard"

config ZMK_SPLIT_ROLE_CENTRAL
	default y

endif

if SHIELD_MYBOARD_LEFT || SHIELD_MYBOARD_RIGHT

config ZMK_SPLIT
	default y

if USB

config USB_NRFX
  default y

config USB_DEVICE_STACK
  default y

endif # USB

config BT_CTLR
  default BT

if ZMK_DISPLAY

config I2C
	default y

config SSD1306
	default y

config SSD1306_REVERSE_MODE
	default y

endif # ZMK_DISPLAY

if LVGL

config LVGL_HOR_RES_MAX
	default 128

config LVGL_VER_RES_MAX
	default 32

config LVGL_VDB_SIZE
	default 64

config LVGL_DPI
	default 148

config LVGL_BITS_PER_PIXEL
	default 1

choice LVGL_COLOR_DEPTH
	default LVGL_COLOR_DEPTH_1
endchoice

endif # LVGL

endif
```
